## Config.in
```kconfig
menu "packages"
  source "$BR2_EXTERNAL_PIBOOTHOS_PATH/package/python-pibooth/Config.in"
  source "$BR2_EXTERNAL_PIBOOTHOS_PATH/package/python-pygame-menu/Config.in"
  source "$BR2_EXTERNAL_PIBOOTHOS_PATH/package/python-pygame-vkeyboard/Config.in"
  source "$BR2_EXTERNAL_PIBOOTHOS_PATH/package/python-pyperclip/Config.in"
endmenu

menu "configuration"

config BR2_WIFI_SETTINGS
	bool "configure wifi"
	help
	  Specify Wifi settings

config BR2_WIFI_SETTINGS_SSID
	string "SSID"
	depends on BR2_WIFI_SETTINGS
	help
	  The ssid of the Wifi connection

config BR2_WIFI_SETTINGS_PASSWORD
	string "Password"
	depends on BR2_WIFI_SETTINGS
	help
	  The password of the wifi connection

config BR2_SECURE_SSH
	bool "secure the SSH connection"
	help
	  Secure the SSH connection with private/public key

config BR2_SECURE_SSH_PUBKEY_PATH
	string "public key path"
	depends on BR2_SECURE_SSH
	help
	  Specify the path to the public key that needs
	  to be added to the ~/.ssh/authorized_keys file
	  of the root and jenkins user.

endmenu
```

## configs/piboothos_rpi4_defconfig
```kconfig
BR2_aarch64=y
BR2_cortex_a72=y
BR2_ARM_FPU_VFPV4=y
BR2_PACKAGE_HOST_LINUX_HEADERS_CUSTOM_5_15=y
BR2_PACKAGE_GLIBC_UTILS=y
BR2_BINUTILS_VERSION_2_37_X=y
BR2_TOOLCHAIN_BUILDROOT_CXX=y
BR2_CPAN_MIRROR="http://cpan.metacpan.org"
BR2_CCACHE=y
BR2_GLOBAL_PATCH_DIR="$(BR2_EXTERNAL_PIBOOTHOS_PATH)/board/rpi_common/patches"
BR2_ROOTFS_DEVICE_CREATION_DYNAMIC_EUDEV=y
BR2_ROOTFS_DEVICE_TABLE="$(BR2_EXTERNAL_PIBOOTHOS_PATH)/board/common/device_table.txt"
BR2_ROOTFS_DEVICE_TABLE_SUPPORTS_EXTENDED_ATTRIBUTES=y
BR2_SYSTEM_BIN_SH_BASH=y
# BR2_TARGET_GENERIC_REMOUNT_ROOTFS_RW is not set
BR2_TARGET_TZ_INFO=y
BR2_TARGET_LOCALTIME="Europe/Brussels"
BR2_ROOTFS_OVERLAY="$(BR2_EXTERNAL_PIBOOTHOS_PATH)/board/rpi_common/overlay $(BR2_EXTERNAL_PIBOOTHOS_PATH)/board/rpi4/overlay"
BR2_ROOTFS_POST_BUILD_SCRIPT="$(BR2_EXTERNAL_PIBOOTHOS_PATH)/board/rpi_common/real-dirs.sh $(BR2_EXTERNAL_PIBOOTHOS_PATH)/board/rpi_common/sw-version.sh $(BR2_EXTERNAL_PIBOOTHOS_PATH)/board/rpi_common/post-build.sh"
BR2_ROOTFS_POST_IMAGE_SCRIPT="$(BR2_EXTERNAL_PIBOOTHOS_PATH)/board/rpi_common/post-image.sh"
BR2_ROOTFS_POST_SCRIPT_ARGS="--rpi4 --linuxdir=$(LINUX_DIR)"
BR2_LINUX_KERNEL=y
BR2_LINUX_KERNEL_CUSTOM_TARBALL=y
BR2_LINUX_KERNEL_CUSTOM_TARBALL_LOCATION="$(call github,raspberrypi,linux,1.20221104)/linux-1.20221104.tar.gz"
BR2_LINUX_KERNEL_DEFCONFIG="bcm2711"
BR2_LINUX_KERNEL_CONFIG_FRAGMENT_FILES="$(BR2_EXTERNAL_PIBOOTHOS_PATH)/board/rpi_common/pibooth.frag $(BR2_EXTERNAL_PIBOOTHOS_PATH)/board/rpi4/usbgadget.frag"
BR2_LINUX_KERNEL_DTS_SUPPORT=y
BR2_LINUX_KERNEL_INTREE_DTS_NAME="broadcom/bcm2711-rpi-4-b"
BR2_PACKAGE_BUSYBOX_CONFIG_FRAGMENT_FILES="$(BR2_EXTERNAL_PIBOOTHOS_PATH)/board/rpi_common/busybox.frag"
BR2_PACKAGE_BUSYBOX_SHOW_OTHERS=y
BR2_PACKAGE_CHECK=y
BR2_PACKAGE_JQ=y
BR2_PACKAGE_DOSFSTOOLS=y
BR2_PACKAGE_DOSFSTOOLS_MKFS_FAT=y
BR2_PACKAGE_E2FSPROGS=y
BR2_PACKAGE_E2FSPROGS_RESIZE2FS=y
BR2_PACKAGE_BRCMFMAC_SDIO_FIRMWARE_RPI=y
BR2_PACKAGE_BRCMFMAC_SDIO_FIRMWARE_RPI_BT=y
BR2_PACKAGE_BRCMFMAC_SDIO_FIRMWARE_RPI_WIFI=y
BR2_PACKAGE_RPI_FIRMWARE=y
BR2_PACKAGE_RPI_FIRMWARE_VARIANT_PI4=y
BR2_PACKAGE_RPI_FIRMWARE_VARIANT_PI4_X=y
# BR2_PACKAGE_EUDEV_ENABLE_HWDB is not set
BR2_PACKAGE_PARTED=y
BR2_PACKAGE_PYTHON3=y
BR2_PACKAGE_PYTHON3_PY_PYC=y
BR2_PACKAGE_PYTHON_PYGAME_IMAGE=y
BR2_PACKAGE_PYTHON_PYGAME_FONT=y
BR2_PACKAGE_PYTHON_PYGAME_MIXER=y
BR2_PACKAGE_LIBSNDFILE=y
BR2_PACKAGE_CA_CERTIFICATES=y
BR2_PACKAGE_LIBOPENSSL_BIN=y
BR2_PACKAGE_LIBCURL_CURL=y
BR2_PACKAGE_NSS_MDNS=y
BR2_PACKAGE_AVAHI=y
BR2_PACKAGE_AVAHI_DAEMON=y
BR2_PACKAGE_CRDA=y
BR2_PACKAGE_DNSMASQ=y
# BR2_PACKAGE_DNSMASQ_TFTP is not set
BR2_PACKAGE_DROPBEAR=y
BR2_PACKAGE_DROPBEAR_DISABLE_REVERSEDNS=y
BR2_PACKAGE_DROPBEAR_WTMP=y
BR2_PACKAGE_DROPBEAR_LASTLOG=y
BR2_PACKAGE_HOSTAPD=y
BR2_PACKAGE_HOSTAPD_WPS=y
# BR2_PACKAGE_IFUPDOWN_SCRIPTS is not set
BR2_PACKAGE_IPROUTE2=y
BR2_PACKAGE_IW=y
BR2_PACKAGE_NTP=y
BR2_PACKAGE_NTP_NTPQ=y
BR2_PACKAGE_RSYNC=y
BR2_PACKAGE_WIRELESS_TOOLS=y
BR2_PACKAGE_WPA_SUPPLICANT=y
BR2_PACKAGE_WPA_SUPPLICANT_AUTOSCAN=y
BR2_PACKAGE_WPA_SUPPLICANT_HOTSPOT=y
BR2_PACKAGE_WPA_SUPPLICANT_DEBUG_SYSLOG=y
BR2_PACKAGE_WPA_SUPPLICANT_CLI=y
BR2_PACKAGE_BASH_COMPLETION=y
BR2_PACKAGE_SCREEN=y
BR2_PACKAGE_RAUC=y
BR2_PACKAGE_RAUC_NETWORK=y
BR2_PACKAGE_UTIL_LINUX_HWCLOCK=y
BR2_TARGET_ROOTFS_EXT2=y
BR2_TARGET_ROOTFS_EXT2_4=y
BR2_TARGET_ROOTFS_EXT2_SIZE="2G"
BR2_TARGET_ROOTFS_TAR_XZ=y
BR2_TARGET_UBOOT=y
BR2_TARGET_UBOOT_BUILD_SYSTEM_KCONFIG=y
BR2_TARGET_UBOOT_CUSTOM_GIT=y
BR2_TARGET_UBOOT_CUSTOM_REPO_URL="https://github.com/u-boot/u-boot"
BR2_TARGET_UBOOT_CUSTOM_REPO_VERSION="v2022.01"
BR2_TARGET_UBOOT_BOARD_DEFCONFIG="rpi_4"
BR2_TARGET_UBOOT_CONFIG_FRAGMENT_FILES="$(BR2_EXTERNAL_PIBOOTHOS_PATH)/board/rpi_common/uboot.config"
BR2_PACKAGE_HOST_DOSFSTOOLS=y
BR2_PACKAGE_HOST_GENIMAGE=y
BR2_PACKAGE_HOST_MTOOLS=y
BR2_PACKAGE_HOST_RAUC=y
BR2_PACKAGE_HOST_UBOOT_TOOLS=y
BR2_PACKAGE_HOST_UBOOT_TOOLS_BOOT_SCRIPT=y
BR2_PACKAGE_HOST_UBOOT_TOOLS_BOOT_SCRIPT_SOURCE="$(BR2_EXTERNAL_PIBOOTHOS_PATH)/board/rpi_common/uboot-boot.ush"
BR2_PACKAGE_PYTHON_PIBOOTH=y
BR2_PACKAGE_PYTHON_PICAMERA=y
BR2_SECURE_SSH=y
BR2_SECURE_SSH_PUBKEY_PATH="$(BR2_EXTERNAL_PIBOOTHOS_PATH)/misc/id_rsa.pub"
```

## package/python-pibooth/Config.in
```kconfig
config BR2_PACKAGE_PYTHON_PIBOOTH
	bool "python-pibooth"
	select BR2_PACKAGE_LIBGPHOTO2
	select BR2_PACKAGE_SDL2
	select BR2_PACKAGE_CUPS
	select BR2_PACKAGE_PYTHON_PILLOW
	select BR2_PACKAGE_PYTHON_PLUGGY
	select BR2_PACKAGE_PYTHON_PSUTIL
	select BR2_PACKAGE_PYTHON_PYGAME_VKEYBOARD
	select BR2_PACKAGE_PYTHON_PYGAME_MENU
	help
	  A Python framework for building reactive web-apps.
	  Developed by Plotly.

	  https://plotly.com/dash
```

## package/python-picamera/Config.in
```kconfig
config BR2_PACKAGE_PYTHON_PICAMERA
	bool "python-picamera"
	select BR2_PACKAGE_RPI_USERLAND
	help
	  A pure Python interface for the Raspberry Pi camera module.

	  http://picamera.readthedocs.io/
```

## package/python-pygame-menu/Config.in
```kconfig
config BR2_PACKAGE_PYTHON_PYGAME_MENU
	bool "python-pygame-menu"
	select BR2_PACKAGE_PYTHON_PYGAME # runtime
	select BR2_PACKAGE_PYTHON_PYPERCLIP # runtime
	select BR2_PACKAGE_PYTHON_TYPING_EXTENSIONS # runtime
	help
	  A menu for pygame. Simple, and easy to use.

	  https://pygame-menu.readthedocs.io
```

## package/python-pygame-vkeyboard/Config.in
```kconfig
config BR2_PACKAGE_PYTHON_PYGAME_VKEYBOARD
	bool "python-pygame-vkeyboard"
	select BR2_PACKAGE_PYTHON_PYGAME # runtime
	help
	  Visual keyboard highly customizable for pygame.

	  https://github.com/Faylixe/pygame-vkeyboard
```
